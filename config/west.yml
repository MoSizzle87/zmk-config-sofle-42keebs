## config/west.yml
```yaml
manifest:
  remotes:
    - name: piit79
      url-base: https://github.com/piit79
  projects:
    - name: zmk
      remote: piit79
      revision: v0.3
      import: app/west.yml
  self:
    path: config
```

## west.yml
```yaml
manifest:
  remotes:
    - name: piit79
      url-base: https://github.com/piit79
  projects:
    - name: zmk
      remote: piit79
      revision: main
      import: app/west.yml
  self:
    path: config
```
